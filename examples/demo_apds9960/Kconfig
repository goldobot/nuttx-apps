## examples/demo_apds9960/Kconfig
```kconfig
#
# For a description of the syntax of this configuration file,
# see the file kconfig-language.txt in the NuttX tools repository.
#

config EXAMPLES_DEMO_APDS9960
	bool "DEMO_APDS9960 C++ example"
	default n
	depends on HAVE_CXX
	---help---
		Enable the DEMO_APDS9960 C++ example

if EXAMPLES_DEMO_APDS9960

config EXAMPLES_DEMO_APDS9960_CXXINITIALIZE
	bool "C++ Initialization"
	default y
	depends on HAVE_CXX && HAVE_CXXINITIALIZE
	---help---
		By default, if CONFIG_HAVE_CXX and CONFIG_HAVE_CXXINITIALIZE are
		defined, then this example will call the NuttX function to
		initialize static C++ constructors.  This option may be disabled,
		however, if that static initialization was performed elsewhere.

endif
```

## examples/goldorak_go/old/PR_Belgique_2018/Kconfig
```kconfig
#
# For a description of the syntax of this configuration file,
# see the file kconfig-language.txt in the NuttX tools repository.
#

config EXAMPLES_GOLDORAK_GO
	bool "Goldorak motor control example"
	default n
	depends on PWM && NSH_BUILTIN_APPS
	---help---
		Enable the Goldorak motor control example example

if EXAMPLES_GOLDORAK_GO

config EXAMPLES_GOLDORAK_GO_PWM_FREQUENCY
	int "Default PWM frequency"
	default 10000
	---help---
		The default PWM frequency.  Default: 10000 Hz


endif
```

## examples/goldorak_go_ioctl/Kconfig
```kconfig
#
# For a description of the syntax of this configuration file,
# see the file kconfig-language.txt in the NuttX tools repository.
#

config EXAMPLES_GOLDORAK_GO_IOCTL
	bool "Goldorak motor control example (using PWM driver IOCTL)"
	default n
	depends on PWM && NSH_BUILTIN_APPS
	---help---
		Enable the Goldorak motor control example (with PWM driver IOCTL) 

if EXAMPLES_GOLDORAK_GO_IOCTL

config EXAMPLES_GOLDORAK_GO_IOCTL_PWM_FREQUENCY
	int "Default PWM frequency"
	default 10000
	---help---
		The default PWM frequency.  Default: 10000 Hz


endif
```

## examples/goldorak_go_simple_test/Kconfig
```kconfig
#
# For a description of the syntax of this configuration file,
# see the file kconfig-language.txt in the NuttX tools repository.
#

config EXAMPLES_GOLDORAK_GO_SIMPLE_TEST
	bool "Goldorak motor control simple example"
	default n
	depends on PWM && NSH_BUILTIN_APPS
	---help---
		Enable the Goldorak motor control simple example (with real-time thread)

if EXAMPLES_GOLDORAK_GO_SIMPLE_TEST

config EXAMPLES_GOLDORAK_GO_SIMPLE_TEST_PWM_FREQUENCY
	int "Default PWM frequency"
	default 10000
	---help---
		The default PWM frequency.  Default: 10000 Hz


endif
```

## examples/robot_master_spi/Kconfig
```kconfig
#
# For a description of the syntax of this configuration file,
# see the file kconfig-language.txt in the NuttX tools repository.
#

config EXAMPLES_ROBOT_MASTER_SPI
	bool "\"Robot master spi\" example"
	default n
	---help---
		Enable the \"Robot master spi\" example

if EXAMPLES_ROBOT_MASTER_SPI

config EXAMPLES_ROBOT_MASTER_SPI_PROGNAME
	string "Program name"
	default "robot_master_spi"
	depends on BUILD_KERNEL
	---help---
		This is the name of the program that will be use when the NSH ELF
		program is installed.

config EXAMPLES_ROBOT_MASTER_SPI_PRIORITY
	int "Robot master spi task priority"
	default 100

config EXAMPLES_ROBOT_MASTER_SPI_STACKSIZE
	int "Robot master spi stack size"
	default 2048

endif
```
